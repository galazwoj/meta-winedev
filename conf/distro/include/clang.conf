## conf/distro/include/clang.conf
```bitbake
# Default toolchain for target binaries: gcc
TOOLCHAIN ?= "gcc"

# To use 'clang' for building target binaries (except components marked 'un-clangable'
# in meta-clang layer), uncomment the following line:
#TOOLCHAIN_aarch64 ?= "clang"

# Wine bug #38886: https://bugs.winehq.org/show_bug.cgi?id=38886
# AArch64 platforms: ABI Problems wrt varargs (needs arm64 specific __builtin_ms_va_list)

# Add clang in generated SDKs for all target archs
CLANGSDK = "1"

# Add clang to images for all target archs
IMAGE_INSTALL_append = " clang"
```

## conf/distro/include/distro-multilib-aarch64.inc
```bitbake
require conf/multilib.conf
MULTILIBS = "multilib:lib32"
DEFAULTTUNE:virtclass-multilib-lib32 = "armv7vethf-neon-vfpv4"
USE_32BIT_PKGS = "1"
# Set RPM_PREFER_ELF_ARCH to configure preferred ABI when using rpm packaging
# backend to generate a rootfs, choices are:
# 1: ELF32 wins
# 2: ELF64 wins
RPM_PREFER_ELF_ARCH ?= "2"
```

## conf/distro/include/distro-multilib.inc
```bitbake
# defaultsetup.inc gets includes after ${DISTRO}.conf, so we need to set it here
# to make the python below work. Local, site and auto.conf will override it.
TCMODE ?= "default"

# Enable multilib conditionally, only for aarch64 with default toolchain combination
# Other combinations aren't supported
def get_multilib_handler(d):
    features = d.getVar('TUNE_FEATURES', True).split()
    tcmode = d.getVar('TCMODE', True)
    if ('aarch64' in features) and (tcmode == "default"):
        distro_multilib = "conf/distro/include/distro-multilib-aarch64.inc"
    else:
        distro_multilib = "conf/distro/include/file-cannot-be-found.inc"
    return distro_multilib

# Use a weak include to avoid to produce an error when the file cannot be found.
# It is the case when we don't want multilib enabled (e.g. on 32bit machines).
include ${@get_multilib_handler(d)}
```

## conf/distro/include/egl.inc
```bitbake
# https://developer.arm.com/products/software/mali-drivers/user-space
MALI_USERLAND_LIBARIES ?= "mali-userland"

# Helper function for overloading the default EGL/GLES implementation.
# The Mali libraries provided by ARM are compatible with the Mesa headers
# and it is safe to use with user space applications linked against Mesa.
def get_egl_handler(d, target):
    """  Overloading the default EGL/GLES implementation."""
    features = d.getVar('MACHINE_FEATURES', True).split()
    tunes = d.getVar("TUNE_FEATURES", True)
    mali_libs = d.getVar('MALI_USERLAND_LIBARIES', True);
    if 'mali-gpu' in features and tunes == "aarch64":
        provider = mali_libs.split()[0]
    else:
        provider = "mesa"
    return provider;

MULTI_PROVIDER_WHITELIST += "virtual/libgl virtual/egl virtual/libgles1 virtual/libgles2"

PREFERRED_PROVIDER_virtual/egl = "${@get_egl_handler(d, 'egl')}"
PREFERRED_PROVIDER_virtual/libgles1 = "${@get_egl_handler(d, 'libgles1')}"
PREFERRED_PROVIDER_virtual/libgles2 = "${@get_egl_handler(d, 'libgles2')}"
```

## conf/distro/winedev.conf
```bitbake
require conf/distro/poky.conf

DISTRO = "winedev"
DISTROOVERRIDES = "poky"
DISTRO_NAME = "Winedev based on Poky (Yocto Project Reference Distro)"
DISTRO_FEATURES += "x11 pam"
+DISTRO_FEATURES += "opengl"
# Ensure download cache is outside of build directory (top-level)
DL_DIR ?= "${TOPDIR}/../downloads"

# Yocto build system builds everything from scratch unless
# BitBake can determine that parts do not need to be rebuilt.
# The Yocto Project implements shared sstate code that supports incremental builds.
SSTATE_DIR ?= "${TOPDIR}/../shared-sstate-cache"

# Inject MACHINE overrides from this layer
include conf/machine/${MACHINE}-override.conf

# Add clang to target images and Yocto SDK
include conf/distro/include/clang.conf

# Wine bug #38719: https://bugs.winehq.org/show_bug.cgi?id=38719
# 64-bit ARM Windows applications from Windows SDK for Windows 10 crash when accessing TEB/PEB members
# (AArch64 platform specific register X18 must be reserved for TEB)
TARGET_CFLAGS:append_aarch64 = " -ffixed-x18 "
```

## conf/layer.conf
```bitbake
BBPATH .= ":${LAYERDIR}"

BBFILES += "\
    ${LAYERDIR}/recipes*/*/*.bb \
    ${LAYERDIR}/recipes*/*/*.bbappend \
    "

BBFILE_COLLECTIONS += "winedev-layer"
BBFILE_PATTERN_winedev-layer := "^${LAYERDIR}/"
BBFILE_PRIORITY_winedev-layer = "10"

LAYERSERIES_COMPAT_winedev-layer = "nanbield"

LAYERDEPENDS_winedev-layer = "core \
    openembedded-layer \
    xfce-layer \
    multimedia-layer \
    networking-layer \
    meta-python \
    "

BBFILES_DYNAMIC += " \
    meta-96boards:${LAYERDIR}/dynamic-layers/meta-96boards/recipes-*/*/*.bb \
    meta-96boards:${LAYERDIR}/dynamic-layers/meta-96boards/recipes-*/*/*.bbappend \
    "
BBMASK = "meta-xfce/recipes-multimedia"
```

## conf/machine/hikey960-override.conf
```bitbake
#@TYPE: Machine
#@NAME: HiKey960 machine
#@DESCRIPTION: HiKey960 development board

require conf/distro/include/distro-multilib.inc

MACHINE_FEATURES += "mali-gpu"
MALI_USERLAND_LIBARIES = "mali-userland-g71"

require conf/distro/include/egl.inc

XSERVER = " \
    xserver-xorg \
    ${@bb.utils.contains('DISTRO_FEATURES', 'opengl', 'mesa-driver-swrast xserver-xorg-extension-glx', '', d)} \
    xf86-video-modesetting \
    xf86-input-evdev \
    xf86-video-fbdev \
    "

CMDLINE_ROOT_EMMC   = "sdd10"
CMDLINE_ROOT_SDCARD = "mmcblk0p2"
CMDLINE = "console=ttyAMA6,115200n8 root=/dev/${CMDLINE_ROOT_SDCARD} rootwait rw efi=noruntime"
# Avoid hangs at boot due to incomplete platform clk tree/DTS which causes disabling of needed clocks
CMDLINE += " clk_ignore_unused=true"
# Fix slow entropy gathering for crng, needs Linux kernel 4.19+ and patch
CMDLINE += " random.trust_cpu=on"
# Enable to trace driver probing issues
#CMDLINE += " debug initcall_debug"
```

## conf/machine/qemuarm64-override.conf
```bitbake
#@TYPE: Machine
#@NAME: Generic QEMU armv8 'virtual' machine
#@DESCRIPTION: Machine configuration for running the generic armv8 virtual platform on QEMU

require conf/distro/include/distro-multilib.inc

# Only raw EXT4 needed
IMAGE_FSTYPES = " ext4"

KERNEL_IMAGETYPE = "Image"
KERNEL_MODULE_AUTOLOAD += " virtio-input "

SERIAL_CONSOLES ?= "115200;ttyAMA0 115200;hvc0"

# add xf86-video-modesetting driver to allow setting reasonable resolutions
XSERVER = " \
    xserver-xorg \
    ${@bb.utils.contains('DISTRO_FEATURES', 'opengl', 'mesa-driver-swrast xserver-xorg-extension-glx', '', d)} \
    xf86-video-modesetting \
    xf86-video-fbdev \
    "

# For runqemu script
QB_SYSTEM_NAME = "qemu-system-aarch64"
QB_MEM = "-m 4096"
QB_MACHINE = "-machine virt"
QB_CPU = "-cpu cortex-a57 -smp 4"

# standard serial console
QB_KERNEL_CMDLINE_APPEND = "console=ttyAMA0"

# use QEMU "monitor" via a UNIX socket
# to connect: socat -,echo=0,icanon=0 unix-connect:qemu-monitor-socket
# to script: echo "info status" | socat - unix-connect:qemu-monitor-socket | tail --lines=+2 | grep -v '^(qemu) '
QB_OPT_APPEND = "-monitor unix:qemu-monitor-socket,server,nowait"

# virtio graphics (gpu) on aarch64 needs special treatment, no VGA
QB_OPT_APPEND += "-device virtio-gpu-gl-pci -display sdl,gl=on,show-cursor=on"

# virtio rng
QB_OPT_APPEND += "-object rng-random,filename=/dev/urandom,id=rng0 -device virtio-rng-pci,rng=rng0"

# virtio input
QB_OPT_APPEND += "-device virtio-tablet-pci -device virtio-keyboard-pci"

# virtio network
QB_TAP_OPT = "-netdev tap,id=net0,ifname=@TAP@,script=no,downscript=no"
QB_NETWORK_DEVICE = "-device virtio-net-device,netdev=net0,mac=@MAC@"

# virtio block device
QB_ROOTFS_OPT = "-drive id=disk0,file=@ROOTFS@,if=none,format=raw -device virtio-blk-device,drive=disk0"

# virtio serial console
QB_SERIAL_OPT = "-device virtio-serial-device -chardev null,id=virtcon -device virtconsole,chardev=virtcon"
QB_TCPSERIAL_OPT = "-device virtio-serial-device -chardev socket,id=virtcon,port=@PORT@,host=127.0.0.1 -device virtconsole,chardev=virtcon"
```
